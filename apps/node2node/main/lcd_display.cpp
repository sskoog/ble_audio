#include "lcd_display.hpp"
#include "status_led.hpp"
#include "esp_log.h"
#include "esp_lcd_panel_io.h"
#include "esp_lcd_panel_vendor.h"
#include "esp_lcd_panel_ops.h"
#include "driver/spi_master.h"
#include "driver/gpio.h"
#include "driver/ledc.h"
#include "led_strip.h"
#include <cstring>
#include <cstdio>

static const char* TAG = "LCD";

namespace Hardware {

static const uint8_t FONT_8X16[96][16] = {
    {0x00,0x00,0x00,0x00,0x00,0x00,0x00,0x00,0x00,0x00,0x00,0x00,0x00,0x00,0x00,0x00}, // ' '
    {0x00,0x00,0x18,0x3C,0x3C,0x3C,0x18,0x18,0x18,0x00,0x18,0x18,0x00,0x00,0x00,0x00}, // '!'
    {0x00,0x66,0x66,0x66,0x24,0x00,0x00,0x00,0x00,0x00,0x00,0x00,0x00,0x00,0x00,0x00}, // '"'
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    {0x00,0x3B,0x6E,0x00,0x00,0x00,0x00,0x00,0x00,0x00,0x00,0x00,0x00,0x00,0x00,0x00}  // '~'
};

LcdDisplay::LcdDisplay() = default;

LcdDisplay::~LcdDisplay() {
    if (m_framebuffer) {
        free(m_framebuffer);
        m_framebuffer = nullptr;
    }
}

esp_err_t LcdDisplay::init() {
    ESP_LOGI(TAG, "Initializing Waveshare ESP32-C6-LCD (ST7789 320x172 Landscape)...");

    // 1. Allocate Framebuffer in DMA/Internal Memory (320 x 172 x 2 = 110,080 bytes)
    size_t fb_size = LCD_WIDTH * LCD_HEIGHT * sizeof(uint16_t);
    m_framebuffer = static_cast<uint16_t*>(heap_caps_malloc(fb_size, MALLOC_CAP_DMA | MALLOC_CAP_INTERNAL));
    if (!m_framebuffer) {
        m_framebuffer = static_cast<uint16_t*>(malloc(fb_size));
        if (!m_framebuffer) {
            ESP_LOGE(TAG, "Failed to allocate framebuffer (%u bytes)", fb_size);
            return ESP_ERR_NO_MEM;
        }
    }
    clear(COLOR_BLACK);

    // 2. Initialize SPI Bus for ST7789 LCD
    spi_bus_config_t buscfg = {};
    buscfg.mosi_io_num = LCD_PIN_MOSI;
    buscfg.miso_io_num = -1;
    buscfg.sclk_io_num = LCD_PIN_SCLK;
    buscfg.quadwp_io_num = -1;
    buscfg.quadhd_io_num = -1;
    buscfg.max_transfer_sz = LCD_WIDTH * LCD_HEIGHT * sizeof(uint16_t);

    esp_err_t ret = spi_bus_initialize(SPI2_HOST, &buscfg, SPI_DMA_CH_AUTO);
    if (ret != ESP_OK && ret != ESP_ERR_INVALID_STATE) {
        ESP_LOGE(TAG, "Failed to initialize SPI bus: %s", esp_err_to_name(ret));
        return ret;
    }

    // 3. Install LCD Panel IO
    esp_lcd_panel_io_handle_t io_handle = nullptr;
    esp_lcd_panel_io_spi_config_t io_config = {};
    io_config.dc_gpio_num = LCD_PIN_DC;
    io_config.cs_gpio_num = LCD_PIN_CS;
    io_config.pclk_hz = 40 * 1000 * 1000; // 40 MHz SPI Clock
    io_config.lcd_cmd_bits = 8;
    io_config.lcd_param_bits = 8;
    io_config.spi_mode = 0;
    io_config.trans_queue_depth = 10;

    ret = esp_lcd_new_panel_io_spi((esp_lcd_spi_bus_handle_t)SPI2_HOST, &io_config, &io_handle);
    if (ret != ESP_OK) {
        ESP_LOGE(TAG, "Failed to create LCD Panel IO: %s", esp_err_to_name(ret));
        return ret;
    }
    m_io_handle = io_handle;

    // 4. Install ST7789 Panel Driver
    esp_lcd_panel_handle_t panel_handle = nullptr;
    esp_lcd_panel_dev_config_t panel_config = {};
    panel_config.reset_gpio_num = LCD_PIN_RST;
    panel_config.rgb_endian = LCD_RGB_ENDIAN_BGR;
    panel_config.bits_per_pixel = 16;

    ret = esp_lcd_new_panel_st7789(io_handle, &panel_config, &panel_handle);
    if (ret != ESP_OK) {
        ESP_LOGE(TAG, "Failed to create ST7789 panel: %s", esp_err_to_name(ret));
        return ret;
    }
    m_panel_handle = panel_handle;

    esp_lcd_panel_reset(panel_handle);
    esp_lcd_panel_init(panel_handle);
    esp_lcd_panel_invert_color(panel_handle, true);
    esp_lcd_panel_swap_xy(panel_handle, true);
    esp_lcd_panel_mirror(panel_handle, true, false);
    // Correct gap for 172x320 panel in landscape (swap_xy=true): X gap = 0, Y gap = (240-172)/2 = 34
    esp_lcd_panel_set_gap(panel_handle, 0, 34);
    esp_lcd_panel_disp_on_off(panel_handle, true);

    // 5. Backlight Configuration (LEDC PWM on GPIO 22)
    ledc_timer_config_t bl_timer = {};
    bl_timer.speed_mode = LEDC_LOW_SPEED_MODE;
    bl_timer.duty_resolution = LEDC_TIMER_10_BIT;
    bl_timer.timer_num = LEDC_TIMER_0;
    bl_timer.freq_hz = 5000;
    bl_timer.clk_cfg = LEDC_AUTO_CLK;
    ledc_timer_config(&bl_timer);

    ledc_channel_config_t bl_channel = {};
    bl_channel.gpio_num = LCD_PIN_BL;
    bl_channel.speed_mode = LEDC_LOW_SPEED_MODE;
    bl_channel.channel = LEDC_CHANNEL_0;
    bl_channel.intr_type = LEDC_INTR_DISABLE;
    bl_channel.timer_sel = LEDC_TIMER_0;
    bl_channel.duty = 256; // Default 25% brightness (256/1023)
    bl_channel.hpoint = 0;
    ledc_channel_config(&bl_channel);

    m_initialized = true;
    clear(COLOR_BLACK);
    drawHeader("ESP32-C6 BLE AUDIO BROADCAST");
    flush();

    ESP_LOGI(TAG, "ST7789 LCD Console Initialized Successfully (320x172 Landscape, gap=(0,34)).");
    return ESP_OK;
}

void LcdDisplay::setBacklight(bool enable) {
    setBacklightBrightness(enable ? 25 : 0);
}

void LcdDisplay::setBacklightBrightness(uint8_t percent) {
    if (percent > 100) percent = 100;
    uint32_t duty = (percent * 1023) / 100;
    ledc_set_duty(LEDC_LOW_SPEED_MODE, LEDC_CHANNEL_0, duty);
    ledc_update_duty(LEDC_LOW_SPEED_MODE, LEDC_CHANNEL_0);
}

void LcdDisplay::clear(uint16_t bg_color) {
    if (!m_framebuffer) return;
    for (int i = 0; i < LCD_WIDTH * LCD_HEIGHT; i++) {
        m_framebuffer[i] = bg_color;
    }
}

void LcdDisplay::drawChar(int x, int y, char c, uint16_t color, uint16_t bg_color) {
    if (c < 32 || c > 126 || !m_framebuffer) return;
    int char_idx = c - 32;
    for (int row = 0; row < 16; row++) {
        uint8_t line = FONT_8X16[char_idx][row];
        for (int col = 0; col < 8; col++) {
            uint16_t pixel_color = (line & (0x80 >> col)) ? color : bg_color;
            int px = x + col;
            int py = y + row;
            if (px >= 0 && px < LCD_WIDTH && py >= 0 && py < LCD_HEIGHT) {
                m_framebuffer[py * LCD_WIDTH + px] = pixel_color;
            }
        }
    }
}

void LcdDisplay::drawString(int x, int y, const char* str, uint16_t color, uint16_t bg_color) {
    if (!str || !m_framebuffer) return;
    int cur_x = x;
    while (*str) {
        if (cur_x + 8 > LCD_WIDTH) break;
        drawChar(cur_x, y, *str, color, bg_color);
        cur_x += 8;
        str++;
    }
}

void LcdDisplay::drawHeader(const char* title) {
    if (!m_framebuffer || !title) return;

    // Draw header bar background (Dark Gray / Yellow Header)
    for (int y = 0; y < 18; ++y) {
        for (int x = 0; x < LCD_WIDTH; ++x) {
            m_framebuffer[y * LCD_WIDTH + x] = COLOR_DARK_GRAY;
        }
    }

    drawString(6, 1, title, COLOR_YELLOW, COLOR_DARK_GRAY);

    // Header Separator Line
    for (int x = 0; x < LCD_WIDTH; ++x) {
        m_framebuffer[18 * LCD_WIDTH + x] = COLOR_CYAN;
        m_framebuffer[19 * LCD_WIDTH + x] = COLOR_CYAN;
    }
}

void LcdDisplay::printLine(int row, const char* text, uint16_t color, uint16_t bg_color) {
    if (row < 0 || row > 8 || !text || !m_framebuffer) return;

    int y = 22 + (row * 18); // Header is 0..19, lines start at y=22 with 18px pitch
    if (y + 16 > LCD_HEIGHT) return;

    // Clear entire line background
    for (int py = y; py < y + 17 && py < LCD_HEIGHT; ++py) {
        for (int px = 0; px < LCD_WIDTH; ++px) {
            m_framebuffer[py * LCD_WIDTH + px] = bg_color;
        }
    }

    drawString(6, y + 1, text, color, bg_color);
}

void LcdDisplay::flush() {
    if (!m_initialized || !m_panel_handle || !m_framebuffer) return;
    auto panel = static_cast<esp_lcd_panel_handle_t>(m_panel_handle);
    esp_lcd_panel_draw_bitmap(panel, 0, 0, LCD_WIDTH, LCD_HEIGHT, m_framebuffer);
}

} // namespace Hardware
